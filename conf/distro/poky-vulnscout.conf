## conf/distro/poky-vulnscout.conf
```bitbake
require conf/distro/poky.conf
require conf/distro/include/vulnscout-core.inc
OE_FRAGMENTS += "core/yocto/sbom-cve-check"
```

## conf/layer.conf
```bitbake
# We have a conf and classes directory, add to BBPATH
BBPATH .= ":${LAYERDIR}"

# We have recipes-* directories, add to BBFILES
BBFILES += "${LAYERDIR}/recipes-*/*/*.bb \
            ${LAYERDIR}/recipes-*/*/*.bbappend"

BBFILE_COLLECTIONS += "meta-vulnscout"
BBFILE_PATTERN_meta-vulnscout = "^${LAYERDIR}/"
BBFILE_PRIORITY_meta-vulnscout = "9"

LAYERDEPENDS_meta-vulnscout = "core"
LAYERSERIES_COMPAT_meta-vulnscout = "scarthgap"

# Update COMMON_LICENSE_DIR to add meta-vulnscout licenses
LICENSE_PATH:append = " ${LAYERDIR}/licenses"

# Add the library path for Python scripts
addpylib ${LAYERDIR}/lib vulnscout
```
